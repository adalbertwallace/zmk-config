## boards/shields/dactylmanuform/Kconfig.defconfig
```kconfig
if SHIELD_DACTYLMANUFORM_LEFT

config ZMK_KEYBOARD_NAME
    default "dactylmanuform"

config ZMK_SPLIT_ROLE_CENTRAL
    default y

endif # SHIELD_DACTYLMANUFORM_LEFT

if SHIELD_DACTYLMANUFORM_LEFT || SHIELD_DACTYLMANUFORM_RIGHT

config ZMK_SPLIT
    default y

endif # SHIELD_DACTYLMANUFORM_LEFT || SHIELD_DACTYLMANUFORM_RIGHT
```
